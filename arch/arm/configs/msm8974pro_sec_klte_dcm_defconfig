## arch/arm/configs/msm8974pro_sec_klte_dcm_defconfig
```kconfig
# K PROJECT config
CONFIG_MACH_KLTE_DCM=y
CONFIG_MACH_KLTE_JPN=y
CONFIG_WLAN_REGION_CODE=100
CONFIG_CHARGER_SMB1357=y
CONFIG_FELICA=y
```

## arch/arm/configs/msm8974pro_sec_klte_kdi_defconfig
```kconfig
# K PROJECT config
CONFIG_ARCH_MSM8974PRO=y
CONFIG_SEC_K_PROJECT=y
CONFIG_MACH_KLTE_KDI=y
CONFIG_MACH_KLTE_JPN=y
CONFIG_WLAN_REGION_CODE=100
CONFIG_CHARGER_SMB1357=y
CONFIG_FELICA=y
```
